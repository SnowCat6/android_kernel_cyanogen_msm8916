## drivers/input/touchscreen/ft5xx/Kconfig
```kconfig
config TOUCHSCREEN_FT5XX
       tristate "FocalTech touchscreens"
       depends on I2C
       help
         Say Y here if you have a ft5XX touchscreen.
	 Ft5xx controllers are multi touch controllers which can
	 report 5 touches at a time.

         If unsure, say N.

         To compile this driver as a module, choose M here: the
         module will be called ft5xx_ts.

config FT5XX_TGESTURE_FUNCTION
       tristate "FocalTech touchscreens gesture"
	depends on TOUCHSCREEN_FT5XX
```
