/* Copyright (c) 2014, The Linux Foundation. All rights reserved.
 *
 * This program is free software; you can redistribute it and/or modify
 * it under the terms of the GNU General Public License version 2 and
 * only version 2 as published by the Free Software Foundation.
 *
 * This program is distributed in the hope that it will be useful,
 * but WITHOUT ANY WARRANTY; without even the implied warranty of
 * MERCHANTABILITY or FITNESS FOR A PARTICULAR PURPOSE.  See the
 * GNU General Public License for more details.
 */

&mdss_mdp {
	dsi_nt35596_1080p_skuk_video: qcom,mdss_dsi_nt35596_1080p_skuk_video {
		qcom,mdss-dsi-panel-name = "nt35596 1080p video mode dsi panel skuk";
		qcom,mdss-dsi-panel-controller = <&mdss_dsi0>;
		qcom,mdss-dsi-panel-type = "dsi_video_mode";
		qcom,mdss-dsi-panel-destination = "display_1";
		qcom,mdss-dsi-panel-framerate = <0x3c>;
		qcom,mdss-dsi-virtual-channel-id = <0x0>;
		qcom,mdss-dsi-stream = <0x0>;
		qcom,mdss-dsi-panel-width = <0x438>;
		qcom,mdss-dsi-panel-height = <0x780>;
		qcom,mdss-dsi-h-front-porch = <0x6e>;
		qcom,mdss-dsi-h-back-porch = <0x5d>;
		qcom,mdss-dsi-h-pulse-width = <0x8>;
		qcom,mdss-dsi-h-sync-skew = <0x0>;
		qcom,mdss-dsi-v-back-porch = <0x7>;
		qcom,mdss-dsi-v-front-porch = <0x3>;
		qcom,mdss-dsi-v-pulse-width = <0x2>;
		qcom,mdss-dsi-bpp = <0x18>;
		qcom,mdss-dsi-color-order = "rgb_swap_rgb";
		qcom,mdss-dsi-underflow-color = <0xff>;
		qcom,mdss-dsi-border-color = <0x0>;
		qcom,mdss-dsi-on-command = <0x29010000 0x2ff 0xee290100 0x2 0xfb012901 0xa00 0x2184029 0x1000014 0x21800 0x29010000 0x2ff 0x5290100 0x50002 0xfb012901 0x0 0x2900029 0x1000000 0x29304 0x29010000 0x294 0x4290100 0x2 0x9b0f2901 0x0 0x2914429 0x1000000 0x29279 0x29010000 0x200 0xf290100 0x2 0x1002901 0x0 0x2020029 0x1000000 0x20300 0x29010000 0x204 0xb290100 0x2 0x50c2901 0x0 0x2060029 0x1000000 0x20700 0x29010000 0x208 0x290100 0x2 0x9002901 0x0 0x20a0329 0x1000000 0x20b04 0x29010000 0x20c 0x1290100 0x2 0xd132901 0x0 0x20e1529 0x1000000 0x20f17 0x29010000 0x210 0xf290100 0x2 0x11002901 0x0 0x2120029 0x1000000 0x21300 0x29010000 0x214 0xb290100 0x2 0x150c2901 0x0 0x2160029 0x1000000 0x21700 0x29010000 0x218 0x290100 0x2 0x19002901 0x0 0x21a0329 0x1000000 0x21b04 0x29010000 0x21c 0x1290100 0x2 0x1d132901 0x0 0x21e1529 0x1000000 0x21f17 0x29010000 0x220 0x9290100 0x2 0x21012901 0x0 0x2220029 0x1000000 0x22300 0x29010000 0x224 0x290100 0x2 0x25ed2901 0x0 0x22f0229 0x1000000 0x23004 0x29010000 0x231 0x49290100 0x2 0x32232901 0x0 0x2330129 0x1000000 0x23400 0x29010000 0x235 0x69290100 0x2 0x36002901 0x0 0x2372d29 0x1000000 0x23818 0x29010000 0x229 0x58290100 0x2 0x2a162901 0x0 0x22b0529 0x1000000 0x25b00 0x29010000 0x25f 0x75290100 0x2 0x63002901 0x0 0x2670429 0x1000000 0x26c00 0x29010000 0x27b 0x80290100 0x2 0x7cd82901 0x0 0x27d6029 0x1000000 0x27e0b 0x29010000 0x27f 0x17290100 0x2 0x80002901 0x0 0x2810629 0x1000000 0x28203 0x29010000 0x283 0x290100 0x2 0x84032901 0x0 0x2850729 0x1000000 0x2861b 0x29010000 0x287 0x39290100 0x2 0x881b2901 0x0 0x2893929 0x1000000 0x28a33 0x29010000 0x2a4 0xf290100 0x2 0x8c012901 0x0 0x2993329 0x1000000 0x2b520 0x29010000 0x2ff 0x1290100 0x2 0xfb012901 0x0 0x2000129 0x1000000 0x20550 0x29010000 0x206 0xa0290100 0x2 0x14a82901 0x0 0x207b229 0x1000000 0x20eb5 0x29010000 0x20f 0xb8290100 0x2 0xb552901 0x0 0x20c5529 0x1000000 0x21128 0x29010000 0x212 0x1f290100 0x2 0x80c2901 0x0 0x2151529 0x1000000 0x21615 0x29010000 0x2ff 0x1290100 0x2 0xfb012901 0x0 0x2750029 0x1000000 0x27610 0x29010000 0x277 0x290100 0x2 0x781d2901 0x0 0x2790029 0x1000000 0x27a32 0x29010000 0x27b 0x290100 0x2 0x7c442901 0x0 0x27d0029 0x1000000 0x27e54 0x29010000 0x27f 0x290100 0x2 0x80632901 0x0 0x2810029 0x1000000 0x28271 0x29010000 0x283 0x290100 0x2 0x847d2901 0x0 0x2850029 0x1000000 0x28689 0x29010000 0x287 0x290100 0x2 0x88b22901 0x0 0x2890029 0x1000000 0x28ad5 0x29010000 0x28b 0x1290100 0x2 0x8c0d2901 0x0 0x28d0129 0x1000000 0x28e3b 0x29010000 0x28f 0x1290100 0x2 0x90872901 0x0 0x2910129 0x1000000 0x292c6 0x29010000 0x293 0x1290100 0x2 0x94c82901 0x0 0x2950229 0x1000000 0x29604 0x29010000 0x297 0x2290100 0x2 0x98472901 0x0 0x2990229 0x1000000 0x29a72 0x29010000 0x29b 0x2290100 0x2 0x9cac2901 0x0 0x29d0229 0x1000000 0x29ed3 0x29010000 0x29f 0x3290100 0x2 0xa0072901 0x0 0x2a20329 0x1000000 0x2a317 0x29010000 0x2a4 0x3290100 0x2 0xa5292901 0x0 0x2a60329 0x1000000 0x2a73d 0x29010000 0x2a9 0x3290100 0x2 0xaa522901 0x0 0x2ab0329 0x1000000 0x2ac6e 0x29010000 0x2ad 0x3290100 0x2 0xae8d2901 0x0 0x2af0329 0x1000000 0x2b0b0 0x29010000 0x2b1 0x3290100 0x2 0xb2bf2901 0x0 0x2b30029 0x1000000 0x2b410 0x29010000 0x2b5 0x290100 0x2 0xb61d2901 0x0 0x2b70029 0x1000000 0x2b832 0x29010000 0x2b9 0x290100 0x2 0xba442901 0x0 0x2bb0029 0x1000000 0x2bc54 0x29010000 0x2bd 0x290100 0x2 0xbe632901 0x0 0x2bf0029 0x1000000 0x2c071 0x29010000 0x2c1 0x290100 0x2 0xc27d2901 0x0 0x2c30029 0x1000000 0x2c489 0x29010000 0x2c5 0x290100 0x2 0xc6b22901 0x0 0x2c70029 0x1000000 0x2c8d5 0x29010000 0x2c9 0x1290100 0x2 0xca0d2901 0x0 0x2cb0129 0x1000000 0x2cc3b 0x29010000 0x2cd 0x1290100 0x2 0xce872901 0x0 0x2cf0129 0x1000000 0x2d0c6 0x29010000 0x2d1 0x1290100 0x2 0xd2c82901 0x0 0x2d30229 0x1000000 0x2d404 0x29010000 0x2d5 0x2290100 0x2 0xd6472901 0x0 0x2d70229 0x1000000 0x2d872 0x29010000 0x2d9 0x2290100 0x2 0xdaac2901 0x0 0x2db0229 0x1000000 0x2dcd3 0x29010000 0x2dd 0x3290100 0x2 0xde072901 0x0 0x2df0329 0x1000000 0x2e017 0x29010000 0x2e1 0x3290100 0x2 0xe2292901 0x0 0x2e30329 0x1000000 0x2e43d 0x29010000 0x2e5 0x3290100 0x2 0xe6522901 0x0 0x2e70329 0x1000000 0x2e86e 0x29010000 0x2e9 0x3290100 0x2 0xea8d2901 0x0 0x2eb0329 0x1000000 0x2ecb0 0x29010000 0x2ed 0x3290100 0x2 0xeebf2901 0x0 0x2ef0029 0x1000000 0x2f010 0x29010000 0x2f1 0x290100 0x2 0xf21d2901 0x0 0x2f30029 0x1000000 0x2f432 0x29010000 0x2f5 0x290100 0x2 0xf6442901 0x0 0x2f70029 0x1000000 0x2f854 0x29010000 0x2f9 0x290100 0x2 0xfa632901 0x0 0x2ff0229 0x1000000 0x2fb01 0x29010000 0x200 0x290100 0x2 0x1712901 0x0 0x2020029 0x1000000 0x2037d 0x29010000 0x204 0x290100 0x2 0x5892901 0x0 0x2060029 0x1000000 0x207b2 0x29010000 0x208 0x290100 0x2 0x9d52901 0x0 0x20a0129 0x1000000 0x20b0d 0x29010000 0x20c 0x1290100 0x2 0xd3b2901 0x0 0x20e0129 0x1000000 0x20f87 0x29010000 0x210 0x1290100 0x2 0x11c62901 0x0 0x2120129 0x1000000 0x213c8 0x29010000 0x214 0x2290100 0x2 0x15042901 0x0 0x2160229 0x1000000 0x21747 0x29010000 0x218 0x2290100 0x2 0x19722901 0x0 0x21a0229 0x1000000 0x21bac 0x29010000 0x21c 0x2290100 0x2 0x1dd32901 0x0 0x21e0329 0x1000000 0x21f07 0x29010000 0x220 0x3290100 0x2 0x21172901 0x0 0x2220329 0x1000000 0x22329 0x29010000 0x224 0x3290100 0x2 0x253d2901 0x0 0x2260329 0x1000000 0x22752 0x29010000 0x228 0x3290100 0x2 0x296e2901 0x0 0x22a0329 0x1000000 0x22b8d 0x29010000 0x22d 0x3290100 0x2 0x2fb02901 0x0 0x2300329 0x1000000 0x231bf 0x29010000 0x232 0x290100 0x2 0x33102901 0x0 0x2340029 0x1000000 0x2351d 0x29010000 0x236 0x290100 0x2 0x37322901 0x0 0x2380029 0x1000000 0x23944 0x29010000 0x23a 0x290100 0x2 0x3b542901 0x0 0x23d0029 0x1000000 0x23f63 0x29010000 0x240 0x290100 0x2 0x41712901 0x0 0x2420029 0x1000000 0x2437d 0x29010000 0x244 0x290100 0x2 0x45892901 0x0 0x2460029 0x1000000 0x247b2 0x29010000 0x248 0x290100 0x2 0x49d52901 0x0 0x24a0129 0x1000000 0x24b0d 0x29010000 0x24c 0x1290100 0x2 0x4d3b2901 0x0 0x24e0129 0x1000000 0x24f87 0x29010000 0x250 0x1290100 0x2 0x51c62901 0x0 0x2520129 0x1000000 0x253c8 0x29010000 0x254 0x2290100 0x2 0x55042901 0x0 0x2560229 0x1000000 0x25847 0x29010000 0x259 0x2290100 0x2 0x5a722901 0x0 0x25b0229 0x1000000 0x25cac 0x29010000 0x25d 0x2290100 0x2 0x5ed32901 0x0 0x25f0329 0x1000000 0x26007 0x29010000 0x261 0x3290100 0x2 0x62172901 0x0 0x2630329 0x1000000 0x26429 0x29010000 0x265 0x3290100 0x2 0x663d2901 0x0 0x2670329 0x1000000 0x26852 0x29010000 0x269 0x3290100 0x2 0x6a6e2901 0x0 0x26b0329 0x1000000 0x26c8d 0x29010000 0x26d 0x3290100 0x2 0x6eb02901 0x0 0x26f0329 0x1000000 0x270bf 0x29010000 0x271 0x290100 0x2 0x72102901 0x0 0x2730029 0x1000000 0x2741d 0x29010000 0x275 0x290100 0x2 0x76322901 0x0 0x2770029 0x1000000 0x27844 0x29010000 0x279 0x290100 0x2 0x7a542901 0x0 0x27b0029 0x1000000 0x27c63 0x29010000 0x27d 0x290100 0x2 0x7e712901 0x0 0x27f0029 0x1000000 0x2807d 0x29010000 0x281 0x290100 0x2 0x82892901 0x0 0x2830029 0x1000000 0x284b2 0x29010000 0x285 0x290100 0x2 0x86d52901 0x0 0x2870129 0x1000000 0x2880d 0x29010000 0x289 0x1290100 0x2 0x8a3b2901 0x0 0x28b0129 0x1000000 0x28c87 0x29010000 0x28d 0x1290100 0x2 0x8ec62901 0x0 0x28f0129 0x1000000 0x290c8 0x29010000 0x291 0x2290100 0x2 0x92042901 0x0 0x2930229 0x1000000 0x29447 0x29010000 0x295 0x2290100 0x2 0x96722901 0x0 0x2970229 0x1000000 0x298ac 0x29010000 0x299 0x2290100 0x2 0x9ad32901 0x0 0x29b0329 0x1000000 0x29c07 0x29010000 0x29d 0x3290100 0x2 0x9e172901 0x0 0x29f0329 0x1000000 0x2a029 0x29010000 0x2a2 0x3290100 0x2 0xa33d2901 0x0 0x2a40329 0x1000000 0x2a552 0x29010000 0x2a6 0x3290100 0x2 0xa76e2901 0x0 0x2a90329 0x1000000 0x2aa8d 0x29010000 0x2ab 0x3290100 0x2 0xacb02901 0x0 0x2ad0329 0x1000000 0x2aebf 0x29010000 0x2af 0x290100 0x2 0xb0102901 0x0 0x2b10029 0x1000000 0x2b21d 0x29010000 0x2b3 0x290100 0x2 0xb4322901 0x0 0x2b50029 0x1000000 0x2b644 0x29010000 0x2b7 0x290100 0x2 0xb8542901 0x0 0x2b90029 0x1000000 0x2ba63 0x29010000 0x2bb 0x290100 0x2 0xbc712901 0x0 0x2bd0029 0x1000000 0x2be7d 0x29010000 0x2bf 0x290100 0x2 0xc0892901 0x0 0x2c10029 0x1000000 0x2c2b2 0x29010000 0x2c3 0x290100 0x2 0xc4d52901 0x0 0x2c50129 0x1000000 0x2c60d 0x29010000 0x2c7 0x1290100 0x2 0xc83b2901 0x0 0x2c90129 0x1000000 0x2ca87 0x29010000 0x2cb 0x1290100 0x2 0xccc62901 0x0 0x2cd0129 0x1000000 0x2cec8 0x29010000 0x2cf 0x2290100 0x2 0xd0042901 0x0 0x2d10229 0x1000000 0x2d247 0x29010000 0x2d3 0x2290100 0x2 0xd4722901 0x0 0x2d50229 0x1000000 0x2d6ac 0x29010000 0x2d7 0x2290100 0x2 0xd8d32901 0x0 0x2d90329 0x1000000 0x2da07 0x29010000 0x2db 0x3290100 0x2 0xdc172901 0x0 0x2dd0329 0x1000000 0x2de29 0x29010000 0x2df 0x3290100 0x2 0xe03d2901 0x0 0x2e10329 0x1000000 0x2e252 0x29010000 0x2e3 0x3290100 0x2 0xe46e2901 0x0 0x2e50329 0x1000000 0x2e68d 0x29010000 0x2e7 0x3290100 0x2 0xe8b02901 0x0 0x2e90329 0x1000000 0x2eabf 0x29010000 0x2ff 0x4290100 0x2 0x7002901 0x0 0x2089229 0x1000000 0x2ff00 0x29010000 0x50002fb 0x1290100 0x2 0xd3092901 0x0 0x2d40429 0x1000000 0x25100 0x29010000 0x253 0x2c290100 0x2 0x55002901 0x7800 0x2110029 0x1000000 0x22900>;
		qcom,mdss-dsi-off-command = [05 01 00 00 32 00 02 28 00 05 01 00 00 78 00 02 10 00];
		qcom,mdss-dsi-on-command-state = "dsi_lp_mode";
		qcom,mdss-dsi-off-command-state = "dsi_hs_mode";
		qcom,mdss-dsi-panel-status-command = [06 01 00 01 05 00 02 0a 08];
		qcom,mdss-dsi-panel-status-command-state = "dsi_lp_mode";
		qcom,mdss-dsi-panel-status-check-mode = "reg_read_nt35596";
		qcom,mdss-dsi-panel-status-value = <0x9c>;
		qcom,mdss-dsi-h-sync-pulse = <0x1>;
		qcom,mdss-dsi-traffic-mode = "burst_mode";
		qcom,mdss-dsi-lane-map = "lane_map_0123";
		qcom,mdss-dsi-bllp-eof-power-mode;
		qcom,mdss-dsi-bllp-power-mode;
		qcom,mdss-pan-physical-width-dimension = <0x3e>;
		qcom,mdss-pan-physical-height-dimension = <0x6e>;
		qcom,mdss-dsi-lane-0-state;
		qcom,mdss-dsi-lane-1-state;
		qcom,mdss-dsi-lane-2-state;
		qcom,mdss-dsi-lane-3-state;
		qcom,mdss-dsi-panel-timings = <0x9e433700 0x60583945 0x5b030400>;
		qcom,mdss-dsi-t-clk-post = <0x1e>;
		qcom,mdss-dsi-t-clk-pre = <0x38>;
		qcom,mdss-dsi-bl-min-level = <0x1>;
		qcom,mdss-dsi-bl-max-level = <0xff>;
		qcom,mdss-dsi-dma-trigger = "trigger_sw";
		qcom,mdss-dsi-mdp-trigger = "none";
		qcom,mdss-dsi-bl-pmic-control-type = "bl_ctrl_dcs";
		qcom,mdss-dsi-reset-sequence = <0x1 0x14 0x0 0x14 0x1 0x14>;
		qcom,cont-splash-enabled;
		qcom,mdss-dsi-pan-enable-dynamic-fps;
		qcom,mdss-dsi-pan-fps-update = "dfps_immediate_porch_mode";
	};
};
